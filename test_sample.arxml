AUTOSAR XML (schema 4.0)
package /TestPackage
  application sw component type TestComponent
    provide port TestPort
