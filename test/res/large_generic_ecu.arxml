AUTOSAR XML (schema 4-3-0)
package /MyECU
  module config Os
    50 x OsTask:
      OsTask_0
        ecuc numerical param value OsTaskActivation: value=1
      OsTask_1
        ecuc numerical param value OsTaskActivation: value=1
      OsTask_2
        ecuc numerical param value OsTaskActivation: value=1
      OsTask_3
        ecuc numerical param value OsTaskActivation: value=1
      OsTask_4
        ecuc numerical param value OsTaskActivation: value=1
      OsTask_5
        ecuc numerical param value OsTaskActivation: value=1
      OsTask_6
        ecuc numerical param value OsTaskActivation: value=1
      OsTask_7
        ecuc numerical param value OsTaskActivation: value=1
      OsTask_8
        ecuc numerical param value OsTaskActivation: value=1
      OsTask_9
        ecuc numerical param value OsTaskActivation: value=1
      OsTask_10
        ecuc numerical param value OsTaskActivation: value=1
      OsTask_11
        ecuc numerical param value OsTaskActivation: value=1
      OsTask_12
        ecuc numerical param value OsTaskActivation: value=1
      OsTask_13
        ecuc numerical param value OsTaskActivation: value=1
      OsTask_14
        ecuc numerical param value OsTaskActivation: value=1
      OsTask_15
        ecuc numerical param value OsTaskActivation: value=1
      OsTask_16
        ecuc numerical param value OsTaskActivation: value=1
      OsTask_17
        ecuc numerical param value OsTaskActivation: value=1
      OsTask_18
        ecuc numerical param value OsTaskActivation: value=1
      OsTask_19
        ecuc numerical param value OsTaskActivation: value=1
      OsTask_20
        ecuc numerical param value OsTaskActivation: value=1
      OsTask_21
        ecuc numerical param value OsTaskActivation: value=1
      OsTask_22
        ecuc numerical param value OsTaskActivation: value=1
      OsTask_23
        ecuc numerical param value OsTaskActivation: value=1
      OsTask_24
        ecuc numerical param value OsTaskActivation: value=1
      OsTask_25
        ecuc numerical param value OsTaskActivation: value=1
      OsTask_26
        ecuc numerical param value OsTaskActivation: value=1
      OsTask_27
        ecuc numerical param value OsTaskActivation: value=1
      OsTask_28
        ecuc numerical param value OsTaskActivation: value=1
      OsTask_29
        ecuc numerical param value OsTaskActivation: value=1
      OsTask_30
        ecuc numerical param value OsTaskActivation: value=1
      OsTask_31
        ecuc numerical param value OsTaskActivation: value=1
      OsTask_32
        ecuc numerical param value OsTaskActivation: value=1
      OsTask_33
        ecuc numerical param value OsTaskActivation: value=1
      OsTask_34
        ecuc numerical param value OsTaskActivation: value=1
      OsTask_35
        ecuc numerical param value OsTaskActivation: value=1
      OsTask_36
        ecuc numerical param value OsTaskActivation: value=1
      OsTask_37
        ecuc numerical param value OsTaskActivation: value=1
      OsTask_38
        ecuc numerical param value OsTaskActivation: value=1
      OsTask_39
        ecuc numerical param value OsTaskActivation: value=1
      OsTask_40
        ecuc numerical param value OsTaskActivation: value=1
      OsTask_41
        ecuc numerical param value OsTaskActivation: value=1
      OsTask_42
        ecuc numerical param value OsTaskActivation: value=1
      OsTask_43
        ecuc numerical param value OsTaskActivation: value=1
      OsTask_44
        ecuc numerical param value OsTaskActivation: value=1
      OsTask_45
        ecuc numerical param value OsTaskActivation: value=1
      OsTask_46
        ecuc numerical param value OsTaskActivation: value=1
      OsTask_47
        ecuc numerical param value OsTaskActivation: value=1
      OsTask_48
        ecuc numerical param value OsTaskActivation: value=1
      OsTask_49
        ecuc numerical param value OsTaskActivation: value=1
