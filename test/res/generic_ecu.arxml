AUTOSAR XML (schema 4-3-0)
package /MyECU
  module config Os
    OsTask
      ecuc numerical param value OsTaskActivation: value=1
    OsEvent
      ecuc textual param value OsEventMask: value=AUTO
    OsCounter
      OsCounterSpecific
        ecuc numerical param value OsCounterValue: value=42
