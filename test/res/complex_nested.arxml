AUTOSAR XML (schema 4-3-0)
package /ComplexECU
  module config EcuM
    EcuMConfiguration
      EcuMCommonConfiguration: EcuMConfigConsistencyHash=123456789
        NestedContainerL1
          NestedContainerL2: SomeParam=DeepValue
